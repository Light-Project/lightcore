## Kconfig
```kconfig
# SPDX-License-Identifier: GPL-2.0-or-later
mainmenu "Lightcore $(KERNELVERSION) Configuration"

source "scripts/include/Kconfig"

source "kernel/Kconfig.general"

source "arch/Kconfig"

source "mm/Kconfig"

source "kernel/Kconfig"

source "kernel/sched/Kconfig"

source "drivers/Kconfig"

source "fs/Kconfig"

source "net/Kconfig"

source "lib/Kconfig"

source "usr/Kconfig"

source "kernel/Kconfig.comp"

source "kernel/Kconfig.debug"

source "boot/Kconfig"
```

## arch/Kconfig
```kconfig
# SPDX-License-Identifier: GPL-2.0-or-later
choice
    prompt "Architecture Select"

config ARCH_ARM
    bool "ARM"
    select ARCH_32BIT
    select ARCH_LITTLE_ENDIAN
    select ARCH_HAS_MMU

config ARCH_CSKY
    bool "C-SKY"
    select ARCH_32BIT
    select ARCH_LITTLE_ENDIAN
    select ARCH_HAS_MMU
    select ARCH_HAS_IOMAP

config ARCH_X86_32
    bool "X86"
    select ARCH_X86
    select ARCH_32BIT
    select ARCH_LITTLE_ENDIAN
    select ARCH_HAS_HUGE_PMD
    select ARCH_HAS_MMU
    select ARCH_HAS_PMIO
    select ARCH_HAS_KASAN
    select ARCH_HAS_CPU_RELAX
    select ARCH_HAS_CPU_IDLE
    select ARCH_HAS_STACKPROTECTOR
    select GENERIC_MPIO
    select LIBGCC_DIVDI3

config ARCH_X86_64
    bool "X86_64"
    select ARCH_X86
    select ARCH_64BIT
    select ARCH_HAS_INT128
    select ARCH_LITTLE_ENDIAN
    select ARCH_HAS_HUGE_PMD
    select ARCH_HAS_HUGE_PUD
    select ARCH_HAS_MMU
    select ARCH_HAS_PMIO
    select ARCH_HAS_KASAN
    select ARCH_HAS_CPU_RELAX
    select ARCH_HAS_CPU_IDLE
    select ARCH_HAS_STACKPROTECTOR
    select PGTABLE_LEVEL5
    select GENERIC_MPIO

config ARCH_XTENSA
    bool "Xtensa"
    select ARCH_32BIT
    select CPU_LITTLE_ENDIAN

endchoice

source "arch/arm/Kconfig"
source "arch/csky/Kconfig"
source "arch/x86/Kconfig"
source "arch/xtensa/Kconfig"

# Architecture supported

config ARCH_X86
    bool

# CPU Wide
config ARCH_32BIT
    bool

config ARCH_64BIT
    bool

config ARCH_HAS_INT128
    bool

# Endianness
config ARCH_LITTLE_ENDIAN
    bool

config ARCH_BIG_ENDIAN
    bool

# Stack Direction
config ARCH_STACK_GROWUP
    bool

# Memory Management
config ARCH_HAS_HUGE_PMD
    bool

config ARCH_HAS_HUGE_PUD
    bool

config ARCH_HAS_HUGE_P4D
    bool

config ARCH_HAS_HUGE_PGD
    bool

config ARCH_HAS_MMU
    bool

config ARCH_HAS_PMIO
    bool

config ARCH_HAS_IOMAP
    bool

config ARCH_HAS_KASAN
    bool

config ARCH_HAS_CPU_RELAX
    bool

config ARCH_HAS_CPU_IDLE
    bool

config ARCH_HAS_STACKPROTECTOR
    bool
```

## arch/arm/Kconfig
```kconfig
menu "Processor type and features"
depends on ARCH_ARM

menu "Multiple platform selection"

config ARCH_ARM_V4
    bool "ARMv4 based platforms (FA526)"
    depends on !ARCH_MULTI_V6_V7
    select ARCH_ARM_V4_V5

config ARCH_ARM_V4T
    bool "ARMv4T based platforms (ARM720T, ARM920T, ...)"
    depends on !ARCH_MULTI_V6_V7
    select ARCH_ARM_V4_V5

config ARCH_ARM_V5
    bool "ARMv5 based platforms (ARM926T, XSCALE, PJ1, ...)"
    depends on !ARCH_MULTI_V6_V7
    select ARCH_ARM_V4_V5

config ARCH_ARM_V6
    bool "ARMv6 based platforms (ARM11)"
    select ARCH_MULTI_V6_V7

config ARCH_ARM_V7
    bool "ARMv7 based platforms (Cortex-A, PJ4, Scorpion, Krait)"
    select ARCH_MULTI_V6_V7

config ARCH_MULTI_V6_V7
    bool

endmenu

choice CPU
    prompt "Architecture Select"

config CPU_ARM926
    bool "based platforms"
    depends on ARCH_ARM_V5
    select CPU_CACHE_V4WT
    select CPU_TLB_V4WBI

config CPU_V6
    bool "based platforms"
    depends on ARCH_ARM_V6

config CPU_V7
    bool "based platforms"
    depends on ARCH_ARM_V7
    select CPU_CACHE_V7
    select CPU_TLB_V7

endchoice
endmenu

# Cache model
config CPU_CACHE_V4WT
    bool

config CPU_CACHE_V4WB
    bool

config CPU_CACHE_V6
    bool

config CPU_CACHE_V7
    bool

# TLB model
config CPU_TLB_V4WT
    bool

config CPU_TLB_V4WB
    bool

config CPU_TLB_V4WBI
    bool

config CPU_TLB_V6
    bool

config CPU_TLB_V7
    bool
```

## arch/arm/mm/Kconfig
```kconfig
# ARM7TDMI
config CPU_ARM7TDMI

# ARM720T
config CPU_ARM720T

# ARM740T
config CPU_ARM740T

# ARM9TDMI
config CPU_ARM9TDMI

# ARM920T
config CPU_ARM920T

# ARM922T
config CPU_ARM922T

# ARM925T
config CPU_ARM925T

# ARM926T
config CPU_ARM926T

# ARM940T
config CPU_ARM940T

# ARM946E-S
config CPU_ARM946

# ARMv7
config CPU_V7E

    
    
# The cache model
config CACHE_V4
    bool

config CACHE_V4WT
    bool

config CACHE_V4WB
    bool

config CACHE_V6
    bool

config CACHE_V7
    bool
```

## arch/arme/Kconfig
```kconfig
menu "Processor type and features"
depends on ARCH_ARME
    
    choice
    prompt "select arch version"
        config ARCH_ARME_V6M
        bool "v6m"
        
        config ARCH_ARME_V7M
        bool "v7m"
        
        config ARCH_ARME_V8M
        bool "v8m"
    endchoice
    
    config ARCH_ARM_V7M_FPU
    bool "enable fpu"
    default n
    
endmenu 
```

## arch/csky/Kconfig
```kconfig
menu "Processor Type and Features"
    depends on ARCH_CSKY

choice
    prompt "CPU MODEL"
    default CPU_CK610

config CPU_CK610
    bool "CSKY CPU ck610"
    select CSKY_ABIV1

config CPU_CK810
    bool "CSKY CPU ck810"
    select CSKY_ABIV2

config CPU_CK807
    bool "CSKY CPU ck807"
    select CSKY_ABIV2

config CPU_CK860
    bool "CSKY CPU ck860"
    select CSKY_ABIV2

endchoice

choice
    prompt "Power Manager Instruction (wait/doze/stop)"
    default CPU_PM_STOP

config CPU_PM_NONE
    bool "none"

config CPU_PM_WAIT
    bool "wait"

config CPU_PM_DOZE
    bool "doze"

config CPU_PM_STOP
    bool "stop"

endchoice

endmenu

config CSKY_ABIV1
    bool

config CSKY_ABIV2
    bool
```

## arch/x86/Kconfig
```kconfig
menu "Processor type and features"
    depends on ARCH_X86_32 || ARCH_X86_64

choice
    prompt "Platform Selection"
    default CPU_686 if ARCH_X86_32
    default CPU_GEN64 if ARCH_X86_64

config CPU_486SX
    bool "486SX"
    depends on ARCH_X86_32
    select CPU_CACHE_SHIFT4

config CPU_486
    bool "486DX"
    depends on ARCH_X86_32
    select CPU_CACHE_SHIFT4

config CPU_586
    bool "586/K5/5x86/6x86/6x86MX"
    depends on ARCH_X86_32
    select CPU_CACHE_SHIFT5

config CPU_586TSC
    bool "Pentium-Classic"
    depends on ARCH_X86_32
    select CPU_CACHE_SHIFT5

config CPU_586MMX
    bool "Pentium-MMX"
    depends on ARCH_X86_32
    select CPU_CACHE_SHIFT5

config CPU_686
    bool "Pentium-Pro"
    depends on ARCH_X86_32
    select CPU_CACHE_SHIFT5

config CPU_PENTIUMII
    bool "Pentium-II/Celeron(pre-Coppermine)"
    depends on ARCH_X86_32
    select CPU_CACHE_SHIFT5

config CPU_PENTIUMIII
    bool "Pentium-III/Celeron(Coppermine)/Pentium-III Xeon"
    depends on ARCH_X86_32
    select CPU_CACHE_SHIFT5

config CPU_PENTIUMM
    bool "Pentium M"
    depends on ARCH_X86_32
    select CPU_CACHE_SHIFT6

config CPU_PENTIUM4
    bool "Pentium-4/Celeron(P4-based)/Pentium-4 M/older Xeon"
    depends on ARCH_X86_32
    select CPU_CACHE_SHIFT7

config CPU_K6
    bool "K6/K6-II/K6-III"
    depends on ARCH_X86_32
    select CPU_CACHE_SHIFT5

config CPU_K7
    bool "Athlon/Duron/K7"
    depends on ARCH_X86_32
    select CPU_CACHE_SHIFT6

config CPU_K8
    bool "Opteron/Athlon64/Hammer/K8"
    depends on ARCH_X86_32
    select CPU_CACHE_SHIFT6

config CPU_CRUSOE
    bool "Crusoe"
    depends on ARCH_X86_32
    select CPU_CACHE_SHIFT5

config CPU_EFFICEON
    bool "Efficeon"
    depends on ARCH_X86_32
    select CPU_CACHE_SHIFT5

config CPU_WINCHIPC6
    bool "Winchip-C6"
    depends on ARCH_X86_32
    select CPU_CACHE_SHIFT5

config CPU_WINCHIP3D
    bool "Winchip-2/Winchip-2A/Winchip-3"
    depends on ARCH_X86_32
    select CPU_CACHE_SHIFT5

config CPU_ELAN
    bool "AMD Elan"
    depends on ARCH_X86_32
    select CPU_CACHE_SHIFT4

config CPU_GEODEGX1
    bool "GeodeGX1"
    depends on ARCH_X86_32
    select CPU_CACHE_SHIFT4

config CPU_GEODE_LX
    bool "Geode GX/LX"
    depends on ARCH_X86_32
    select CPU_CACHE_SHIFT5

config CPU_CYRIXIII
    bool "CyrixIII/VIA-C3"
    depends on ARCH_X86_32
    select CPU_CACHE_SHIFT5

config CPU_VIAC3_2
    bool "VIA C3-2 (Nehemiah)"
    depends on ARCH_X86_32
    select CPU_CACHE_SHIFT5

config CPU_VIAC7
    bool "VIA C7"
    depends on ARCH_X86_32
    select CPU_CACHE_SHIFT6

config CPU_PSC
    bool "Intel P4 / older Netburst based Xeon"
    depends on ARCH_X86_64
    select CPU_CACHE_SHIFT7

config CPU_CORE2
    bool "Core 2/newer Xeon"
    select CPU_CACHE_SHIFT6

config CPU_ATOM
    bool "Intel Atom"
    select CPU_CACHE_SHIFT6

config CPU_GEN64
    bool "Generic x86_64"
    depends on ARCH_X86_64
    select CPU_CACHE_SHIFT6

endchoice

config X86_PAE
    bool "Physical Address Extension (PAE) Support"
    depends on ARCH_X86_32

choice
    prompt "IO Delay Type"
    default IO_DELAY_0X80

config IO_DELAY_0X80
    bool "Use 0x80 port for IO delay (default)"

config IO_DELAY_0XEB
    bool "Use 0xeb port for IO delay"

config IO_DELAY_UDELAY
    bool "Use udelay for IO delay"

config IO_DELAY_NONE
    bool "None IO delay"

endchoice

choice
    prompt "Previous Console Choice"
    default PRECON_SER

config PRECON_VGA
    bool "VGA"

config PRECON_SER
    bool "Serial"

endchoice

config CPU_CACHE_SHIFT7
    bool

config CPU_CACHE_SHIFT6
    bool

config CPU_CACHE_SHIFT5
    bool

config CPU_CACHE_SHIFT4
    bool

config CPU_CACHE_SHIFT
    int
    default "7" if CPU_CACHE_SHIFT7
    default "6" if CPU_CACHE_SHIFT6
    default "5" if CPU_CACHE_SHIFT5
    default "4" if CPU_CACHE_SHIFT4

endmenu
```

## arch/xtensa/Kconfig
```kconfig
menu "Processor Type and Features"
    depends on ARCH_XTENSA

choice
    prompt "Processor Configuration"

config XTENSA_VARIANT_LX106
    bool "LX106"
    select ARCH_HAS_NOMMU
    select ARCH_HAS_XIP
    select ARCH_HAS_PRE_PRINTK

endchoice

source "arch/xtensa/variants/lx106/Kconfig"

endmenu
```

## boot/Kconfig
```kconfig
# SPDX-License-Identifier: GPL-2.0-or-later
menu "Boot Options"

config LOGO
    bool "Display logo on Startup"
    depends on VIDEO
    default y

config PACK_KERNEL
    bool "Generate packaged kernel"
    depends on !XIP
    default y
    help
        uncompressed kernel image. This option is usually used for
        on-chip execution.

choice
    prompt "Kernel compression mode"
    depends on PACK_KERNEL
    default PACK_GZIP

config PACK_GZIP
    bool "Gzip"
    help
        The old and tried gzip compression. It provides a good balance
        between compression ratio and decompression speed.

endchoice # Kernel compression mode"

source "boot/kboot/Kconfig"
source "boot/preload/Kconfig"

endmenu # Boot Options
```

## boot/kboot/Kconfig
```kconfig
# SPDX-License-Identifier: GPL-2.0-or-later
config EFI_STUB
    bool "EFI stub support"

config LOAD_ADDR
    hex "Boot load physical address"
    default 0x00
    help
        The physical address where the boot image is loaded
```

## boot/kboot/x86/Kconfig
```kconfig
# SPDX-License-Identifier: GPL-2.0-or-later
menu "X86 Kernel Bootloader Config"
    depends on ARCH_X86

choice
    prompt "Kboot Console Choice"
    default KBOOT_CON_SER

config KBOOT_CON_VGA
    bool "VGA"

config KBOOT_CON_SER
    bool "UART"

endchoice # Kboot Console Choice
endmenu # X86 Kernel Bootloader Config
```

## boot/preload/Kconfig
```kconfig
menuconfig PRELOAD
    bool "Builtin Preload(Replace Bootloader)"
if PRELOAD

config PRELOAD_DEBUG
    bool "Preoad Generate Debug File"
    default y

choice
    prompt "Chip Platform Selection"

config CHIP_X86
    depends on ARCH_X86
    bool "X86"

config CHIP_ESP8266
    depends on ARCH_XTENSA
    bool "esp8266"

config CHIP_GX6605S
    depends on ARCH_CSKY
    bool "NationalChip GX6605s Support"

config CHIP_SUNIV
    depends on ARCH_ARM
    bool "Allwinner F-series SoCs Support"

endchoice

source "boot/preload/suniv/Kconfig"
source "boot/preload/gx6605s/Kconfig"
source "boot/preload/bios/Kconfig"

endif
```

## boot/preload/bios/Kconfig
```kconfig
# SPDX-License-Identifier: GPL-2.0-or-later
menu "Bios Preload Config"
    depends on CHIP_X86

config PRELOAD_EXTENDED
    bool "Extended Mode"
    default y

choice
    prompt "Preload Console Choice"
    default PRELOAD_CON_SER

config PRELOAD_CON_VGA
    bool "VGA"

config PRELOAD_CON_SER
    bool "UART"

endchoice # Preload Console Choice
endmenu # Bios Preload Config
```

## boot/preload/gx6605s/Kconfig
```kconfig
if CHIP_GX6605S
    comment "GX6605S Bootloader Config"

config PRELOAD_CPU_CLK
    int "CPU Clock Speed"
    default 540

config PRELOAD_AXI_CLK
    int "AXI Clock Speed"
    default 270

config PRELOAD_AHB_CLK
    int "AHB Clock Speed"
    default 135

config PRELOAD_APB_CLK
    int "APB Clock Speed"
    default 54

config PRELOAD_DRAM_CLK
    int "DRAM Clock Speed"
    default 400

config PRELOAD_UART_CLK
    int "Serial Clock Speed"
    default 115200

config PRELOAD_WDT
    bool "Reboot when Panic (WDT)"
    default n

endif
```

## boot/preload/suniv/Kconfig
```kconfig
if CHIP_SUNIV
    comment "Suniv Bootloader Config"

config PRELOAD_CPU_CLK
    int "CPU Clock Speed"
    range 200 800
    default 480
    help
        Too high frequency will make the FEL unavailable

config PRELOAD_BUS_CLK
    int "Bus Clock Speed"
    range 150 300
    default 200
    help
        Too low a frequency will make bus unavailable

config PRELOAD_DRAM_CLK
    int "DRAM Clock Speed"
    range 24 480
    default 312

config PRELOAD_SPI_CLK
    int "Norflash Clock Speed"
    default 20

config PRELOAD_MMC
    bool "Support Boot From MMC (JTAG not available)"
    default y

config PRELOAD_MMC_CLK
    int "MMC Clock Speed"
    depends on PRELOAD_MMC
    default 20

config PRELOAD_UART_CLK
    int "Serial Clock Speed"
    default 115200

endif
```

## boot/preload/sunxif1/Kconfig
```kconfig
menu "Sunxif1 bootloader config"
depends on BOOTLOADER_ENABLE
depends on CHIP_SUNXIF1
    
    choice BOOTLOADER_BOOT_MODE
    prompt "Choice Sunxif1 boot media"
    default BOOTLOADER_BOOT_MODE_NOR
    
        config BOOTLOADER_BOOT_MODE_NOR
        bool "boot from Norflash"
        
        config BOOTLOADER_BOOT_MODE_SD
        bool "boot from sdcard"
    
    endchoice
    
    menu "chip clock system"
        config BOOTLOADER_CPU_CLK
        int "CPU frequency"
        default 800000000
        
        config BOOTLOADER_SYS_CLK
        int "System-Bus frequency"
        default 480000000
        
        config BOOTLOADER_DDR_CLK
        int "DDR frequency"
        default 240000000
        
        config BOOTLOADER_SPI_CLK
        int "norflash frequency"
        default 300000
        
        config BOOTLOADER_UART_CLK
        int "Sys-Uart frequency"
        default 115200
    endmenu

    
endmenu
 
```

## boot/preload/sunxih3/Kconfig
```kconfig
menu "Sunxih3 bootloader config"
depends on BOOTLOADER_ENABLE
depends on CHIP_SUNXIH3

    choice BOOTLOADER_BOOT_MODE
    prompt "Choice Sunxih3 boot media"
    default BOOTLOADER_BOOT_MODE_NOR
    
        config BOOTLOADER_BOOT_MODE_NOR
        bool "boot from Norflash"
        
        config BOOTLOADER_BOOT_MODE_SD
        bool "boot from sdcard"
    
    endchoice
    
    config BOOTLOADER_CPU_CLK
    int "Set CPU clock"
    default 1008000000
    
    config BOOTLOADER_SYS_CLK
    int "Set System clock"
    default 600000000
    
    config BOOTLOADER_DDR_CLK
    int "Set DDR clock"
    default 816000000
    
endmenu
 
```

## configs/armv5_multi_defconfig
```kconfig
# Default configuration of armv5 multi

# arch
CONFIG_ARCH_ARM=y
CONFIG_ARCH_ARM_V5=y

# mem
CONFIG_MMU=y
CONFIG_PAGE_OFFSET=0xc0000000
CONFIG_HIGHMAP_OFFSET=0xf0000000

CONFIG_SPARCEMEM=y

CONFIG_RAM_PAD=0x8000
CONFIG_REGION_HIMEM=y
CONFIG_HIGHMEM_OFFSET=0x30000000

# drivers
CONFIG_DT=y

CONFIG_GPIO=y

CONFIG_SPI=y
CONFIG_SPI_SUNIV=y

CONFIG_UART=y
CONFIG_UART_8250=y
CONFIG_UART_8250_CON=y

CONFIG_RESET=y
CONFIG_RESET_SUNIV=y

CONFIG_VIDEO=y
CONFIG_VIDEO_PL11X=y

# kboot
CONFIG_LOAD_ADDR=0x1000000
```
