## configs/esp32_defconfig
```kconfig
# Minimum configuration of esp32

CONFIG_ARCH_XTENSA=y
CONFIG_XTENSA_VARIANT_ESP32=y

CONFIG_XIP_BASE=0x400ca000
CONFIG_PAGE_OFFSET=0x3ffa000

CONFIG_FRAMEWORK_DT=y
CONFIG_FRAMEWORK_I2C=y
CONFIG_FRAMEWORK_I2S=y
CONFIG_FRAMEWORK_SPI=y
CONFIG_FRAMEWORK_UART=y
CONFIG_FRAMEWORK_MMC=y
CONFIG_FRAMEWORK_PWM=y

CONFIG_CHIP_ESP32=y
CONFIG_PRELOAD=y
```

## configs/esp8266_defconfig
```kconfig
# Default configuration of esp8266

# arch
CONFIG_ARCH_XTENSA=y
CONFIG_XTENSA_VARIANT_LX106=y

# mem
CONFIG_XIP=y
CONFIG_XIP_BASE=0x40208000
CONFIG_PAGE_OFFSET=0x3FFE8000

# drivers
CONFIG_DT=y
CONFIG_I2S=y
CONFIG_SPI=y
CONFIG_UART=y

CONFIG_WATCHDOG=y
CONFIG_WATCHDOG_ESP8266=y

# preload
CONFIG_CHIP_ESP8266=y
CONFIG_PRELOAD=y
```

## configs/gx6605s_defconfig
```kconfig
# Default configuration of GX6605s

# arch
CONFIG_ARCH_CSKY=y

# mem
CONFIG_MMU=y
CONFIG_PAGE_OFFSET=0x80000000
CONFIG_IOREMAP_OFFSET=0xa0000000
CONFIG_HIGHMAP_OFFSET=0xc0000000

CONFIG_SPARCEMEM=y

CONFIG_RAM_PAD=0x10000000
CONFIG_REGION_HIMEM=y
CONFIG_HIGHMEM_OFFSET=0x20000000

# drivers
CONFIG_DT=y
CONFIG_BUILTIN_DTB=y
CONFIG_BUILTIN_DTB_PATH="boot/dts/gx6605s.dtb"

CONFIG_IRQCHIP_GX6605S=y
CONFIG_CLKSRC_GX6605=y

CONFIG_CLK=y
CONFIG_CLK_GX6605=y

CONFIG_GPIO=y
CONFIG_GPIO_GENERIC=y

CONFIG_RTC=y
CONFIG_RTC_GX6605S=y

CONFIG_SPI=y
CONFIG_SPI_GX6605S=y

CONFIG_UART=y
CONFIG_UART_8250=y

CONFIG_VIDEO=y
CONFIG_VIDEO_GX6605S=y

CONFIG_WATCHDOG=y
CONFIG_WATCHDOG_GX6605S=y

# kboot
CONFIG_LOAD_ADDR=0x92000000

# preload
CONFIG_PRELOAD=y
CONFIG_CHIP_GX6605S=y
```

## configs/rk3399_defconfig
```kconfig
# Default configuration of rockchip rk3399

# arch
CONFIG_ARCH_ARM64=y

# mem
CONFIG_MMU=y
CONFIG_PAGE_OFFSET=0xffff000000000000
CONFIG_HIGHMAP_OFFSET=0xf0000000

CONFIG_SPARCEMEM=y

CONFIG_RAM_BASE=0
CONFIG_REGION_HIMEM=y
CONFIG_HIGHMEM_OFFSET=0x30000000

# drivers
CONFIG_DT=y
CONFIG_BUILTIN_DTB=y
CONFIG_BUILTIN_DTB_PATH="boot/dts/raspi-2b.dtb"

CONFIG_GPIO=y

CONFIG_UART=y
CONFIG_UART_8250=y
CONFIG_UART_8250_CON=y

CONFIG_VIDEO=y

# kboot
CONFIG_LOAD_ADDR=0

# perload
CONFIG_CHIP_RK3399=y
CONFIG_PRELOAD=y
```

## configs/stm32f4xx_defconfig
```kconfig
# Minimum configuration of stm32f4xx

CONFIG_ARCH_ARME=y

CONFIG_XIP_BASE=0x08000000
CONFIG_PAGE_OFFSET=0x20000000

CONFIG_FRAMEWORK_DT=y
CONFIG_FRAMEWORK_SPI=y
CONFIG_FRAMEWORK_UART=y
CONFIG_FRAMEWORK_RTC=y
CONFIG_FRAMEWORK_USB=y
```

## configs/suniv_defconfig
```kconfig
# Default configuration of suniv

# arch
CONFIG_ARCH_ARM=y
CONFIG_ARCH_ARM_V5=y

# mem
CONFIG_MMU=y
CONFIG_PAGE_OFFSET=0xc0000000
CONFIG_HIGHMAP_OFFSET=0xf0000000

CONFIG_SPARCEMEM=y

CONFIG_RAM_BASE=0x80000000
CONFIG_REGION_HIMEM=y
CONFIG_HIGHMEM_OFFSET=0x30000000

# drivers
CONFIG_DT=y
CONFIG_BUILTIN_DTB=y
CONFIG_BUILTIN_DTB_PATH="boot/dts/neopi-nano.dtb"

CONFIG_CLK=y

CONFIG_GPIO=y

CONFIG_SPI=y
CONFIG_SPI_SUNIV=y

CONFIG_UART=y
CONFIG_UART_8250=y
CONFIG_UART_8250_CON=y

CONFIG_RESET=y
CONFIG_RESET_SUNIV=y

CONFIG_VIDEO=y

# kboot
CONFIG_LOAD_ADDR=0x81000000

# perload
CONFIG_CHIP_SUNIV=y
CONFIG_PRELOAD=y
```
