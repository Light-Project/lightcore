## usr/selftest/benchmark/Kconfig
```kconfig
# SPDX-License-Identifier: GPL-2.0-or-later
menuconfig SELFTEST_BENCHMARK
    bool "Benchmark"
    default y
if SELFTEST_BENCHMARK

config SELFTEST_MARK_CRC4
    bool "crc4"
    default y

config SELFTEST_MARK_CRC4
    bool "crc7"
    default y

config SELFTEST_MARK_CRC8
    bool "crc8"
    default y

config SELFTEST_MARK_CRC16
    bool "crc16"
    default y

config SELFTEST_MARK_CRC32
    bool "crc32"
    default y

config SELFTEST_MARK_CRC64
    bool "crc64"
    default y

config SELFTEST_MARK_CRC_CCITT
    bool "crc-ccitt"
    default y

config SELFTEST_MARK_CRC_CCITTF
    bool "crc-ccittf"
    default y

config SELFTEST_MARK_CRC_ITUT
    bool "crc-itut"
    default y

config SELFTEST_MARK_CRC_T10DIF
    bool "crc-t10dif"
    default y

config SELFTEST_MARK_CRC_ROCKSOFT
    bool "crc-rocksoft"
    default y

config SELFTEST_MARK_MEMCHR
    bool "memchr"
    default y

config SELFTEST_MARK_MEMCMP
    bool "memcmp"
    default y

config SELFTEST_MARK_MEMCPY
    bool "memcpy"
    default y

config SELFTEST_MARK_MEMMOVE
    bool "memmove"
    default y

config SELFTEST_MARK_MEMSCAN
    bool "memscan"
    default y

config SELFTEST_MARK_MEMSET
    bool "memset"
    default y

config SELFTEST_MARK_STRCMP
    bool "strcmp"
    default y

config SELFTEST_MARK_STRLEN
    bool "strlen"
    default y

config SELFTEST_MARK_STRNCMP
    bool "strncmp"
    default y

config SELFTEST_MARK_STRNICMP
    bool "strnicmp"
    default y

config SELFTEST_MARK_STRNLEN
    bool "strnlen"
    default y

endif
```

## usr/selftest/control/Kconfig
```kconfig
# SPDX-License-Identifier: GPL-2.0-or-later
menuconfig SELFTEST_CONTROL
	bool "Contol algorithm library"
	default y
if SELFTEST_CONTROL

config SELFTEST_FILTER_PIDI
	bool "pidi"
	default y

config SELFTEST_FILTER_PIDR
	bool "pidr"
	default y

config SELFTEST_FILTER_WINEXT
	bool "winext"
	default y

endif # SELFTEST_CONTROL
```

## usr/selftest/driver/Kconfig
```kconfig
# SPDX-License-Identifier: GPL-2.0-or-later
menuconfig SELFTEST_DRIVER
    bool "Test Driver Unit"
    default y
if SELFTEST_DRIVER

config SELFTEST_DRIVER_BUZZER
    bool "Buzzer Unit Tests"
    depends on BUZZER
    default y

config SELFTEST_DRIVER_GPIO
    bool "GPIO Unit Tests"
    depends on GPIO
    default y

config SELFTEST_DRIVER_HWMON
    bool "HWMON Unit Tests"
    depends on HWMON
    default y

config SELFTEST_DRIVER_RNG
    bool "RNG Unit Tests"
    depends on RNG
    default y

config SELFTEST_DRIVER_RTC
    bool "RTC Unit Tests"
    depends on RTC
    default y

config SELFTEST_DRIVER_VIDEO
    bool "Video Unit Tests"
    depends on VIDEO
    default y

endif
```

## usr/selftest/filter/Kconfig
```kconfig
# SPDX-License-Identifier: GPL-2.0-or-later
menuconfig SELFTEST_FILTER
	bool "Test Filter Unit"
	default y
if SELFTEST_FILTER

config SELFTEST_FILTER_EWMA
	bool "ewma"
	default y

config SELFTEST_FILTER_MEAN
	bool "mean"
	default y

config SELFTEST_FILTER_MEDIAN
	bool "median"
	default y

endif # SELFTEST_FILTER
```

## usr/selftest/kernel/Kconfig
```kconfig
# SPDX-License-Identifier: GPL-2.0-or-later
menuconfig SELFTEST_KERNEL
    bool "Test Kernel Unit"
    default y
if SELFTEST_KERNEL

config SELFTEST_KERNEL_IRQPOLL
    bool "irqpoll"
    default y

config SELFTEST_KERNEL_KCORO
    bool "kernel coroutine"
    default y

config SELFTEST_KERNEL_PRANDOM
    bool "pseudo random"
    default y

config SELFTEST_KERNEL_RANDOM
    bool "random"
    default y

config SELFTEST_KERNEL_SOFTIRQ
    bool "softirq"
    default y

config SELFTEST_KERNEL_SYSCALL
    bool "syscall"
    default y

config SELFTEST_KERNEL_TIMER
    bool "timer"
    default y

endif
```

## usr/selftest/kshell/Kconfig
```kconfig
# SPDX-License-Identifier: GPL-2.0-or-later
menuconfig SELFTEST_KSHELL
    bool "Test Kshell Unit"
    default y
if SELFTEST_KSHELL

config SELFTEST_KSHELL_PARSER
    bool "Kshell Parser Unit Tests"
    default y

endif
```

## usr/selftest/lib/Kconfig
```kconfig
# SPDX-License-Identifier: GPL-2.0-or-later
menuconfig SELFTEST_LIB
    bool "Test Library Unit"
    default y
if SELFTEST_LIB

config SELFTEST_LIB_BITOPS
    bool "Bitops Test"
    default y

config SELFTEST_LIB_BTREE
    bool "Balance Tree Test"
    default y

config SELFTEST_LIB_DIV64
    bool "Div64 libgcc Test"
    depends on ARCH_32BIT
    default y

config SELFTEST_LIB_DCALL
    bool "Dynamic Call Test"
    default y

config SELFTEST_LIB_GLOB
    bool "Glob Parser Test"
    default y

config SELFTEST_LIB_HEAP
    bool "Heap Test"
    default y

config SELFTEST_LIB_HLIST
    bool "Hash List Test"
    default y

config SELFTEST_LIB_IDR
    bool "IDR Test"
    default y

config SELFTEST_LIB_ILIST
    bool "Index List Test"
    default y

config SELFTEST_LIB_JSON
    bool "Json Parser Test"
    default y

config SELFTEST_LIB_KFIFO
    bool "Kfifo Test"
    default y

config SELFTEST_LIB_LIBCPIO
    bool "Libcpio Test"
    depends on ROMDISK
    default y

config SELFTEST_LIB_LIST
    bool "List Test"
    default y

config SELFTEST_LIB_MEMDUMP
    bool "Hexdump Test"
    default y

config SELFTEST_LIB_MINPOOL
    bool "Minpool Test"
    default y

config SELFTEST_LIB_NCACHE
    bool "Ncache Test"
    default y

config SELFTEST_LIB_RANGE
    bool "Range Test"
    default y

config SELFTEST_LIB_RBTREE
    bool "Rbtree Test"
    default y

config SELFTEST_LIB_SEGTREE
    bool "Segtree Test"
    default y

config SELFTEST_LIB_SKIPLIST
    bool "Skip List Test"
    default y

config SELFTEST_LIB_SLIST
    bool "Single List Test"
    default y

config SELFTEST_LIB_SORT
    bool "Sort Unit Test"
    default y

config SELFTEST_LIB_TQUEUE
    bool "Timerqueue Unit Test"
    default y

config SELFTEST_LIB_UUID
    bool "UUID Unit Test"
    default y

config SELFTEST_LIB_XML
    bool "Xml Unit Test"
    default y

endif
```

## usr/selftest/math/Kconfig
```kconfig
# SPDX-License-Identifier: GPL-2.0-or-later
menuconfig SELFTEST_MATH
    bool "Test Math library Unit"
    default y
if SELFTEST_MATH

config SELFTEST_MATH_BEZIER3
    bool "Bezier3"
    default y

config SELFTEST_MATH_RATIONAL
    bool "Rational"
    default y

endif # SELFTEST_MATH
```

## usr/selftest/memory/Kconfig
```kconfig
# SPDX-License-Identifier: GPL-2.0-or-later
menuconfig SELFTEST_MEMORY
    bool "Test Memory Alloc"
    default y
if SELFTEST_MEMORY

config SELFTEST_MEMORY_BUDDY
    bool "Page Buddy Test"
    default y

config SELFTEST_MEMORY_IOREMAP
    bool "IO Remap Test"
    default y

config SELFTEST_MEMORY_KCACHE
    bool "Kernel Cache Test"
    default y

config SELFTEST_MEMORY_KMALLOC
    bool "Kernel Malloc Test"
    default y

config SELFTEST_MEMORY_MEMPOOL
    bool "Memory Pool Test"
    default y

config SELFTEST_MEMORY_VMALLOC
    bool "Virtual Malloc Test"
    default y

config SELFTEST_MEMORY_VMEM
    bool "Virtual Memory Test"
    default y

endif
```

## usr/selftest/string/Kconfig
```kconfig
# SPDX-License-Identifier: GPL-2.0-or-later
menuconfig SELFTEST_STRING
    bool "Test Lib String"
    default y
if SELFTEST_STRING

config SELFTEST_STRING_MEMCHR
    bool "Memchr Test"
    default y

config SELFTEST_STRING_MEMCMP
    bool "Memcmp Test"
    default y

config SELFTEST_STRING_MEMCPY
    bool "Memcpy Test"
    default y

config SELFTEST_STRING_MEMMOVE
    bool "Memmove Test"
    default y

config SELFTEST_STRING_MEMSCAN
    bool "Memscan Test"
    default y

config SELFTEST_STRING_MEMSET
    bool "Memset Test"
    default y

config SELFTEST_STRING_STRCMP
    bool "Strcmp Test"
    default y

config SELFTEST_STRING_STRLEN
    bool "Strlen Test"
    default y

config SELFTEST_STRING_STRNCMP
    bool "Strncmp Test"
    default y

config SELFTEST_STRING_STRNICMP
    bool "Strnicmp Test"
    default y

config SELFTEST_STRING_STRNLEN
    bool "Strnlen Test"
    default y

endif
```
