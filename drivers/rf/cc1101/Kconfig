## drivers/rng/Kconfig
```kconfig
# SPDX-License-Identifier: GPL-2.0-or-later
menuconfig RNG
    bool "Random Number Generator (RNG) Support"
if RNG

config RNG_INTEL_RDRAND
    bool "Intel Core RNG Support"
    depends on ARCH_X86

config RNG_INTEL_PCH
    bool "Intel PCH RNG Support"
    depends on ARCH_X86 && PCI

endif
```

## drivers/rtc/Kconfig
```kconfig
# SPDX-License-Identifier: GPL-2.0-or-later
menuconfig RTC
    bool "Real Time Clock (RTC) Support"
if RTC

config RTC_HCTOSYS
    bool "Set time from RTC on Startup and Resume"
    default y

config RTC_GX6605S
    tristate "GX6605S RTC Support"

config RTC_MC146818
    tristate "MC146818 RTC Support"
    depends on IRQCHIP_DT

endif
```

## drivers/serio/Kconfig
```kconfig
# SPDX-License-Identifier: GPL-2.0-or-later
menuconfig SERIO
    bool "Serio Device Support"
if SERIO

config SERIO_I8042
    bool "I8042 PS2 Support"

endif
```

## drivers/sound/Kconfig
```kconfig
# SPDX-License-Identifier: GPL-2.0-or-later
menuconfig SND
    bool "Sound Card Device Support"
if SND

config SND_ES1370
    bool "ES1370 Sound Support"

config SND_PCSPKR
    bool "PC-Speaker Sound Support"
    depends on CLKEVT_I8253

endif
```

## drivers/spi/Kconfig
```kconfig
# SPDX-License-Identifier: GPL-2.0-or-later
menuconfig SPI
    bool "Serial Peripheral Interface (SPI) Support"
if SPI

config SPI_GX6605S
    bool "GX6605S SPI Support"
    depends on ARCH_CSKY

config SPI_SUNIV
    bool "Allwinner F-series SPI Support"
    depends on ARCH_ARM

endif
```

## drivers/tty/Kconfig
```kconfig
# SPDX-License-Identifier: GPL-2.0-or-later
menuconfig TTY
    bool "TTY Device Support"
if TTY

endif
```

## drivers/uart/8250/Kconfig
```kconfig
menuconfig UART_8250
    bool "UART8250 support"
if UART_8250

config UART_8250_ISA
    bool "8250 ISA support"

config UART_8250_PCI
    bool "8250 PCI support"

endif

config UART_8250_CON
    bool "Devicetree based probing for 8250 ports"
```

## drivers/uart/Kconfig
```kconfig
# SPDX-License-Identifier: GPL-2.0-or-later
menuconfig UART
    bool "Universal Asynchronous Receiver Transmitter (UART) Support"
if UART

source "drivers/uart/8250/Kconfig"

config UART_CH340
    bool "CH340/CH341 UART support"

config UART_ESP
    bool "Espressif UART support"

endif
```

## drivers/usb/Kconfig
```kconfig
# SPDX-License-Identifier: GPL-2.0-or-later
menuconfig USB
    bool "Universal Serial Bus (USB) Support"
if USB

source "drivers/usb/host/Kconfig"

endif
```

## drivers/usb/host/Kconfig
```kconfig
# SPDX-License-Identifier: GPL-2.0-or-later
comment "USB Host Controller Drivers"

config USB_OHCI
    bool "OHCI HCD (USB 1.1) Support"
if USB_OHCI

config USB_OHCI_PLATFORM
    bool "OHCI Platform Support"
    depends on DT

config USB_OHCI_PCI
    bool "OHCI PCI Support"
    depends on PCI

endif # USB_OHCI

config USB_UHCI
    bool "UHCI HCD (USB 1.1) Support"
if USB_UHCI

config USB_OHCI_PLATFORM
    bool "UHCI Platform Support"
    depends on DT

config USB_UHCI_PCI
    bool "UHCI PCI Support"
    depends on PCI

endif # USB_UHCI

config USB_EHCI
    bool "UHCI HCD (USB 1.0) Support"
if USB_EHCI

config USB_OHCI_PLATFORM
    bool "EHCI Platform Support"
    depends on DT

config USB_EHCI_PCI
    bool "EHCI PCI Support"
    depends on PCI

endif # USB_EHCI
```

## drivers/video/Kconfig
```kconfig
# SPDX-License-Identifier: GPL-2.0-or-later
menuconfig VIDEO
    bool "Video Device Support"
if VIDEO

config FBCON
    bool "FrameBuffer Console Support"
    select FONT
    select FONT_6X8

config VIDEO_GX6605S
    bool "Nationalchip gx6605s FrameBuffer Support"

config VIDEO_I810
    bool "I810 FrameBuffer Support"

config VIDEO_PL11X
    bool "PL11x FrameBuffer Support"

config VIDEO_SIMPLE
    bool "Simple FrameBuffer Support"

source "drivers/video/vbe/Kconfig"

endif
```

## drivers/video/vbe/Kconfig
```kconfig
# SPDX-License-Identifier: GPL-2.0-or-later
menuconfig VIDEO_VBE
    bool "VBE Device Support"
if VIDEO_VBE

config VBE_BOCHS
    bool "Bochs Dispi VGA Interface Support"

config VBE_VBOX
    bool "VBOX Dispi VGA Interface Support"

endif
```

## drivers/watchdog/Kconfig
```kconfig
# SPDX-License-Identifier: GPL-2.0-only
menuconfig WATCHDOG
    bool "Watchdog Device Support"
if WATCHDOG

config WATCHDOG_POWER
    bool "Watchdog power operations"
    default y

config WATCHDOG_ESP8266
    bool "ESP8266 Watchdog"

config WATCHDOG_GX6605S
    bool "GX6605S Watchdog"
    select POWER

config WATCHDOG_IB700
    bool "Ibase IB700 Watchdog"

config WATCHDOG_TCO
    bool "Intel TCO Watchdog"
    depends on ARCH_X86 && MFD_ICH

endif
```

## fs/Kconfig
```kconfig
# SPDX-License-Identifier: GPL-2.0-or-later
menu "File Systems"

source "fs/cpio/Kconfig"

source "fs/romfs/Kconfig"

endmenu
```

## fs/minix/Kconfig
```kconfig
# SPDX-License-Identifier: GPL-2.0-or-later
config FS_MINIX
    bool "Minix File System Support"
```

## kernel/Kconfig
```kconfig
# SPDX-License-Identifier: GPL-2.0-or-later
menu "Executable File Formats"

config BINFMT_ELF
    bool ""
    default y

config BINFMT_SCRIPTS
    bool ""
    default y

endmenu

source "kernel/sched/Kconfig"
```

## kernel/Kconfig.comp
```kconfig
# SPDX-License-Identifier: GPL-2.0-or-later
menu "Compile Config"

config CC_IS_GCC
	def_bool $(success,test "$(cc-name)" = GCC)

config CC_IS_CLANG
	def_bool $(success,test "$(cc-name)" = Clang)

choice
    prompt "Compiler Optimization Level"
    default CC_OPTIMIZE_FOR_DEBUG

config CC_OPTIMIZE_FOR_DEBUG
    bool "Optimize for Debug (-O0)"

config CC_OPTIMIZE_FOR_PERFORMANCE
    bool "Optimize for Performance (-O2)"

config CC_OPTIMIZE_FOR_SIZE
    bool "Optimize for Size (-Os)"

endchoice # Compiler Optimization Level

config STRICT
    bool "Compiling Kernel with Strict mode"
    default y
    help
        Use -Wall and -Werror, To ensure kernel
        security, please keep it open in the mainline

config STACKPROTECTOR
	bool "Stack Protector buffer overflow detection"
	depends on ARCH_HAS_STACKPROTECTOR
	depends on $(cc-option,-fstack-protector)
	default y

config STACKPROTECTOR_STRONG
	bool "Strong Stack Protector"
	depends on STACKPROTECTOR
	depends on $(cc-option,-fstack-protector-strong)
	default y

config KERNEL_DEBUG
    bool "Kernel Generate Debug File"
    depends on CC_OPTIMIZE_FOR_DEBUG || CC_OPTIMIZE_FOR_PERFORMANCE
    default y

config KERNEL_MAP
    bool "Kernel Generate Map File"
    default y

config KERNEL_DUMP
    bool "Kernel Generate Dump File"
    default y

config LD_DEAD_CODE_DATA_ELIMINATION
    bool "Dead Code and Data Elimination"
    depends on EXPERT

endmenu # Compile Config
```

## kernel/Kconfig.debug
```kconfig
# SPDX-License-Identifier: GPL-2.0-or-later
menu "Kernel Hacking"
source "kernel/printk/Kconfig"

config DEBUG_KERNEL
    bool "Kernel debugging"
    default y

config CONSTRUCTORS
    bool

menuconfig KASAN
    bool "Runtime Memory Monitor Support"
    depends on DEBUG_KERNEL && ARCH_HAS_KASAN
if KASAN

choice
    prompt "KASAN Mode Select"
    default KASAN_GENERIC

config KASAN_GENERIC
    bool "Generic Mode"
    select CONSTRUCTORS

endchoice # KASAN Mode Select

config KASAN_SHADOW_OFFSET
    hex "KASAN Shadow Offset"

config KASAN_ALL
    bool "Enable instrumentation for the entire kernel"
    default y

endif # KASAN

menuconfig UBSAN
    bool "Undefined Behaviour Sanity Checker"
    depends on DEBUG_KERNEL
    default y
if UBSAN

config UBSAN_SHIFT
    bool "Perform checking for bit-shift overflows"
    default UBSAN
    depends on $(cc-option,-fsanitize=shift)
    default y

config UBSAN_DIV_ZERO
    bool "Perform checking for integer divide-by-zero"
    depends on $(cc-option,-fsanitize=integer-divide-by-zero)
    default y

config UBSAN_UNREACHABLE
    bool "Perform checking for unreachable code"
    depends on $(cc-option,-fsanitize=unreachable)
    default y

config UBSAN_BOOL
    bool "Perform checking for non-boolean values used as boolean"
    depends on $(cc-option,-fsanitize=bool)
    default y

config UBSAN_ENUM
    bool "Perform checking for out of bounds enum values"
    depends on $(cc-option,-fsanitize=enum)
    default y

config UBSAN_ALIGNMENT
    bool "Perform checking for misaligned pointer usage"
    depends on $(cc-option,-fsanitize=alignment)
    default y

config UBSAN_ALL
    bool "Enable instrumentation for the entire kernel"
    default y

endif # UBSAN

menuconfig KGCOV
    bool "Enable gcov-based kernel profiling"
    depends on DEBUG_KERNEL
	select CONSTRUCTORS
    default y
if KGCOV

config KGCOV_ALL
    bool "Enable instrumentation for the entire kernel"
    default y

endif # KGCOV

menu "Device Driver Debugging"

config DEBUG_DEVRES
	bool "Managed device resources verbose debug messages"
	depends on DEBUG_KERNEL
    default y

endmenu # Device Driver Debugging

menu "Scheduler Debugging"

config DEBUG_PREEMPT
    bool "preemptible kernel"
    depends on DEBUG_KERNEL && PREEMPTION
    default y

endmenu # Scheduler Debugging

menu "Debug Lockups"

config DEBUG_SPINLOCK
    bool "Debug spinlock deadlock"
    depends on DEBUG_KERNEL
    default y

endmenu # Debug Lockups

menu "Memory Debugging"

config DEBUG_SLOB
    bool "Debug slob out of bounds"
    depends on DEBUG_KERNEL && MM_SLOB
    default y

config DEBUG_MEMBLOCK
    bool "Debug memblock"
    depends on DEBUG_KERNEL
    default y

endmenu # Memory Debugging

menu "Debugging data structures"

config DEBUG_LIST
    bool "Debug list manipulation"
    depends on DEBUG_KERNEL
    default y

config DEBUG_HLIST
    bool "Debug hash List manipulation"
    depends on DEBUG_KERNEL
    default y

config DEBUG_SLIST
    bool "Debug single List manipulation"
    depends on DEBUG_KERNEL
    default y

config DEBUG_ILIST
    bool "Debug index List manipulation"
    depends on DEBUG_KERNEL
    default y

config DEBUG_RBTREE
    bool "Debug rbtree manipulation"
    depends on DEBUG_KERNEL
    default y

config DEBUG_REFCOUNT
    bool "Debug refcount saturation"
    depends on DEBUG_KERNEL
    default y

endmenu # Debug data structures
endmenu # Kernel Hacking
```

## kernel/Kconfig.general
```kconfig
# SPDX-License-Identifier: GPL-2.0-or-later
menu "General Setup"

config DEFAULT_HOSTNAME
    string "Default hostname"
    default "Lightcore"

config DEFAULT_INIT
    string "Default Init path"
    default "init"

config EXPERT
    bool "Configure Standard Kernel Features"
    default n

config SMP
    bool "Symmetric Multi Processing Support"
    depends on ARCH_HAS_SMP

config SYSVIPC
    bool "System V IPC"
    default y

config SYSTICK_FREQ
    int "System Tick Frequency"
    range 100 1000
    default 1000

config HIRES_TIMER_DELAY
    bool "Use high-res timer to do delay operations"
    default y

config VMAP_STACK
    bool "Use Virtually Mapped Stack"
    default y

config KSHELL
    bool "Kernel Shell Support"
    default y

config BOOT_PARAMS
    bool "Accept Kernel Instructions"
    default y

config BUILTIN_DTB
    bool "Builtin DTB"
    depends on DT

config BUILTIN_DTB_PATH
    string "Builtin DTB path"
    depends on BUILTIN_DTB

source "kernel/irq/Kconfig"

endmenu

config VERSION
    string
    default $(KERNELVERSION)
```

## kernel/device/Kconfig
```kconfig
# SPDX-License-Identifier: GPL-2.0-or-later
config ISA_BUS
    bool "ISA Bus Support"
    default y
```
