## drivers/hwmon/Kconfig
```kconfig
# SPDX-License-Identifier: GPL-2.0-or-later
menuconfig HWMON
    bool "Hardware Monitor Device Support"
if HWMON

config HWMON_AMD_K10
    bool "AMD-K10 Hwmon"
    depends on ARCH_X86

config HWMON_CORETEMP
    bool "Intel Coretemp Hwmon"
    depends on ARCH_X86

config HWMON_DELL_SMM
    bool "Dell-SMM Hwmon"
    depends on ARCH_X86

config HWMON_DHT11
    bool "DHT11 Hwmon"
    depends on GPIO

config HWMON_DME1737
    bool "DME1737 Hwmon"

config HWMON_PCF8591
    bool "PCF8591 Hwmon"
    depends on I2C

endif
```

## drivers/i2c/Kconfig
```kconfig
# SPDX-License-Identifier: GPL-2.0-or-later
menuconfig I2C
    bool "Inter Integrated Circuit (I2C) Support"
if I2C

config I2C_DT
    bool "I2C Device Tree Linkage"
    depends on DT
    default y

config I2C_BITBANGING
    bool "I2C Bitbanging Support"

config I2C_GPIO
    bool "GPIO I2C Bridge"
    depends on GPIO
    select I2C_BITBANGING

config I2C_I801
    bool "Intel 82801 Support"
    depends on ARCH_X86 && PCI

endif
```

## drivers/input/Kconfig
```kconfig
# SPDX-License-Identifier: GPL-2.0-or-later
menuconfig INPUT
    bool "Input Device Support"
if INPUT

source "drivers/input/keyboard/Kconfig"

source "drivers/input/mouse/Kconfig"

endif
```

## drivers/input/keyboard/Kconfig
```kconfig
# SPDX-License-Identifier: GPL-2.0-or-later
menuconfig INPUT_KEYBOARD
    bool "Input keyboard support"
if INPUT_KEYBOARD

config INPUT_ATKBD
    bool "AT and PS/2 keyboard support"
    depends on SERIO

endif
```

## drivers/input/mouse/Kconfig
```kconfig
# SPDX-License-Identifier: GPL-2.0-or-later
menuconfig INPUT_MOUSE
    bool "Input mouse support"
if INPUT_MOUSE

config INPUT_PSMSE
    bool "PS/2 mouse support"
    depends on SERIO

endif
```

## drivers/iomux/Kconfig
```kconfig
# SPDX-License-Identifier: GPL-2.0-or-later
menuconfig INPUT
    bool "Input Device Support"
if INPUT
```

## drivers/irq/Kconfig
```kconfig
menu "irq support"

config CSKY_APB_INTC
    bool "C-SKY APB Interrupt Controller"
    depends on CSKY
    help
    Say yes here to enable C-SKY APB interrupt controller driver used
    by C-SKY single core SOC system. It uses mmio map apb-bus to visit
    the controller's register.

endmenu
```

## drivers/irqchip/Kconfig
```kconfig
# SPDX-License-Identifier: GPL-2.0-or-later
menu "IRQ Chip Device Support"

config IRQCHIP_DT
    bool "IRQ Chip Device Tree Linkage"
    depends on DT
    default y

config IRQCHIP_8259
    bool "I8259 Interrupt Controller"
    depends on ARCH_X86 && DT
    default y

config IRQCHIP_GX6605S
    bool "GX6605s Interrupt Controller"
    depends on ARCH_CSKY && DT
    default y

config IRQCHIP_SUNIV
    bool "Suniv Interrupt Controller"
    depends on ARCH_ARM && DT
    default y

endmenu
```

## drivers/led/Kconfig
```kconfig
# SPDX-License-Identifier: GPL-2.0-or-later
menuconfig LED
    bool "LED Device Support"
if LED

source "drivers/led/trigger/Kconfig"

config LED_GPIO
    bool "GPIO LED Bridge"
    depends on DT
    default y

config LED_DME1737
    bool "DME1737 LED"
    depends on HWMON_DME1737

endif
```

## drivers/led/trigger/Kconfig
```kconfig
# SPDX-License-Identifier: GPL-2.0-or-later
menuconfig LED_TRIGGER
    bool "Led Trigger Support"
    default y
if LED_TRIGGER

config LED_TRIGGER_POWER
    bool "Led Power Trigger"
    default y

config LED_TRIGGER_PERIODIC
    bool "Led Periodic Trigger"
    default y

config LED_TRIGGER_HEARTBEAT
    bool "Led Heartbeat Trigger"
    default y

config LED_TRIGGER_HEARTBEAT_PERIOD
    int "Led Heartbeat Period"
    depends on LED_TRIGGER_HEARTBEAT
    default 1260

endif # LED_TRIGGERS
```

## drivers/mfd/Kconfig
```kconfig
# SPDX-License-Identifier: GPL-2.0-or-later
menuconfig MFD
    bool "Multifunction Device (MFD) Support"
if MFD

config MFD_ICH
    bool "Intel ICH Multifunction Support"

endif
```

## drivers/mtd/Kconfig
```kconfig
# SPDX-License-Identifier: GPL-2.0-or-later
menuconfig MTD
    bool "Memory Technology Device (MTD) Support"
if MTD

source "drivers/mtd/spinor/Kconfig"

endif
```

## drivers/mtd/romdisk/Kconfig
```kconfig
# SPDX-License-Identifier: GPL-2.0-or-later
config ROMDISK
    bool "Romdisk support"
    select FS_CPIO
```

## drivers/mtd/spinor/Kconfig
```kconfig
menuconfig SPINOR
    bool "Memory Technology Device support"
if SPINOR

config SPINOR_INTEL
    bool "intel PCH/PCU SPI flash driver support"
    depends on ARCH_X86 && MFD_ICH

config SPINOR_ICH
    bool "intel Legacy SPI flash driver support"
    depends on ARCH_X86 && MFD_ICH

endif
```

## drivers/net/Kconfig
```kconfig
# SPDX-License-Identifier: GPL-2.0-or-later
menuconfig NETD
    bool "Network Device Support"
if NETD

source "drivers/net/ethernet/Kconfig"

endif
```

## drivers/net/ethernet/Kconfig
```kconfig
menuconfig NETD_ETH
    bool "Ethernet Driver Support"
if NETD_ETH

config ETH_E1000
    tristate "Intel(R) PRO/1000 Gigabit Ethernet Support"
    depends on PCI

config ETH_RTL8139
    tristate "RealTek RTL-8129/8130/8139 PCI Fast Ethernet Adapter Support"
    depends on PCI

endif
```

## drivers/nfc/mf522/Kconfig
```kconfig
# SPDX-License-Identifier: GPL-2.0-or-later
menuconfig NFC
    bool "Near Field Communication (NFC) Support"
if NFC

config NFC_MFC522
	bool "MF522 Support"

endif
```

## drivers/parallel/Kconfig
```kconfig
# SPDX-License-Identifier: GPL-2.0-or-later
menuconfig PARALLEL
    bool "Parallel Device (IEEE1284) Support"
if PARALLEL

config PARALLEL_DT
    bool "Parallel Device Tree Linkage"
    depends on DT
    default y

config PARALLEL_I8255
    bool "I8255 Parallel Support"

endif
```

## drivers/pci/Kconfig
```kconfig
# SPDX-License-Identifier: GPL-2.0-or-later
menuconfig PCI
    bool "Peripheral Component Interconnect (PCI) Support"
if PCI

config PCI_GENERIC
    bool "Generic PCI Support"
    depends on DT

config PCI_I386
    bool "I386 PCI Support"
    depends on ARCH_X86 && DT

endif
```

## drivers/platform/Kconfig
```kconfig
# SPDX-License-Identifier: GPL-2.0-or-later
menuconfig PLATFORM
    bool "Platform Device Support"
if PLATFORM

source "drivers/platform/pvpanic/Kconfig"

endif
```

## drivers/platform/pvpanic/Kconfig
```kconfig
# SPDX-License-Identifier: GPL-2.0-or-later
config PVPANIC
    bool "Pvpanic device support"

config PVPANIC_PLATFORM
    depends on PVPANIC && (ACPI || DT)
    bool "Pvpanic platform support"

config PVPANIC_PCI
    depends on PVPANIC && PCI
    bool "Pvpanic PCI support"
```

## drivers/power/Kconfig
```kconfig
# SPDX-License-Identifier: GPL-2.0-or-later
menuconfig POWER
    bool "Power Device Support"
if POWER

config POWER_CE4100
    bool "CE4100 Power Support"
    depends on ARCH_X86

config POWER_CS5530A
    bool "CS5530A Power Support"
    depends on ARCH_X86

config POWER_CS5536
    bool "CS5536 Power Support"
    depends on ARCH_X86

config POWER_HISI
    bool "HISI Power Support"

config POWER_PIIX
    bool "PIIX Power Support"
    depends on ARCH_X86

config POWER_PIIX4
    bool "PIIX4 Power Support"
    depends on ARCH_X86

config POWER_RDC321X
    bool "RDC321X Power Support"
    depends on ARCH_X86

endif
```

## drivers/ps2/Kconfig
```kconfig
menuconfig PS2
    bool "PS2 device support"
if PS2

config PS2_I8042
    bool "I8042 PS2 support"

endif
```

## drivers/reset/Kconfig
```kconfig
# SPDX-License-Identifier: GPL-2.0-or-later
menuconfig RESET
    bool "Reset Device Support"
if RESET

config RESET_SUNIV
    bool "Suniv Reset Support"
    depends on ARCH_ARM

endif
```
