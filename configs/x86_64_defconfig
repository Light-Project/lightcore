## configs/x86_64_defconfig
```kconfig
# Default configuration of x86 computer

# arch
CONFIG_ARCH_X86_64=y

# mem
CONFIG_MMU=y
CONFIG_PAGE_OFFSET=0xffffffff00000000
CONFIG_HIGHMAP_OFFSET=0xffffffffc0000000

CONFIG_SPARCEMEM=y

CONFIG_RAM_BASE=0
CONFIG_REGION_DMA=y
CONFIG_DMA_SIZE=0x1000000
CONFIG_REGION_DMA32=y
CONFIG_DMA32_SIZE=0xFF000000
CONFIG_REGION_HIMEM=y
CONFIG_HIGHMEM_OFFSET=0x49000000

# drivers
CONFIG_ACPI=y

CONFIG_BLOCK=y
CONFIG_BLK_FLOPPY=y
CONFIG_BLK_ATASIM=y
CONFIG_BLK_ATASIM32=y

CONFIG_DT=y
CONFIG_BUILTIN_DTB=y
CONFIG_BUILTIN_DTB_PATH="boot/dts/ibmpc.dtb"

CONFIG_FIRMWARE=y
CONFIG_FIRMWARE_DMI=y
CONFIG_FIRMWARE_QEMU=y

CONFIG_I2C=y
CONFIG_I2C_I801=y
CONFIG_I2C_PIIX4=y

CONFIG_INPUT=y
CONFIG_INPUT_KEYBOARD=y
CONFIG_INPUT_ATKBD=y
CONFIG_INPUT_MOUSE=y
CONFIG_INPUT_PSMSE=y

CONFIG_MFD=y
CONFIG_MFD_ICH=y

CONFIG_MTD=y
CONFIG_ROMDISK=y
CONFIG_SPINOR=y
CONFIG_SPINOR_ICH=y
CONFIG_SPINOR_INTEL=y

CONFIG_NETD=y
CONFIG_NETD_ETH=y
CONFIG_ETH_E1000=y
CONFIG_ETH_RTL8139=y

CONFIG_PARALLEL=y
CONFIG_PARALLEL_I8255=y

CONFIG_PCI=y
CONFIG_PCI_I386=y

CONFIG_POWER=y
CONFIG_POWER_CE4100=y
CONFIG_POWER_CS5530A=y
CONFIG_POWER_CS5536=y
CONFIG_POWER_PIIX=y
CONFIG_POWER_PIIX4=y
CONFIG_POWER_RDC321X=y

CONFIG_RTC=y
CONFIG_RTC_MC146818=y

CONFIG_SND=y
CONFIG_SND_ES1370=y
CONFIG_SND_PCSPKR=y

CONFIG_UART=y
CONFIG_UART_8250=y
CONFIG_UART_8250_ISA=y

CONFIG_USB=y
CONFIG_USB_UHCI=y
CONFIG_USB_EHCI=y

CONFIG_VIDEO=y
CONFIG_VIDEO_VBE=y
CONFIG_VBE_BOCHS=y
CONFIG_VBE_VBOX=y

CONFIG_WATCHDOG=y
CONFIG_WATCHDOG_TCO=y

# fs
CONFIG_FS_CPIO=y

# kboot
CONFIG_LOAD_ADDR=0

# perload
CONFIG_CHIP_X86=y
CONFIG_PRELOAD=y
```

## configs/x86_defconfig
```kconfig
# SPDX-License-Identifier: GPL-2.0-or-later
# Default configuration of x86 computer

# arch
CONFIG_ARCH_X86_32=y

# mem
CONFIG_MMU=y
CONFIG_PAGE_OFFSET=0xc0000000
CONFIG_HIGHMAP_OFFSET=0xf0000000
CONFIG_HIGHMAP_SIZE=0xffff000

CONFIG_SPARCEMEM=y
CONFIG_SPARCE_SHIFT=26

CONFIG_RAM_BASE=0
CONFIG_REGION_DMA=y
CONFIG_DMA_SIZE=0x1000000
CONFIG_REGION_HIMEM=y
CONFIG_HIGHMEM_OFFSET=0x30000000

# drivers
CONFIG_ACPI=y

CONFIG_BLOCK=y
CONFIG_BLK_FLOPPY=y
CONFIG_BLK_ATASIM=y
CONFIG_BLK_ATASIM32=y

CONFIG_BUZZER=y
CONFIG_BUZZER_PCSPKR=y

CONFIG_CPUIDLE=y
CONFIG_CPUIDLE_HALTPOLL=y

CONFIG_DT=y
CONFIG_BUILTIN_DTB=y
CONFIG_BUILTIN_DTB_PATH="boot/dts/virtual-pc.dtb"

CONFIG_FIRMWARE=y
CONFIG_FIRMWARE_DMI=y
CONFIG_FIRMWARE_QEMU=y

CONFIG_GPIO=y
CONFIG_GPIO_INTEL_ICH=y
CONFIG_GPIO_PARALLEL=y

CONFIG_HWMON=y
CONFIG_HWMON_CORETEMP=y

CONFIG_I2C=y
CONFIG_I2C_I801=y
CONFIG_I2C_PIIX4=y

CONFIG_INPUT=y
CONFIG_INPUT_KEYBOARD=y
CONFIG_INPUT_ATKBD=y
CONFIG_INPUT_MOUSE=y
CONFIG_INPUT_PSMSE=y

CONFIG_MFD=y
CONFIG_MFD_ICH=y

CONFIG_MTD=y
CONFIG_ROMDISK=y
CONFIG_SPINOR=y
CONFIG_SPINOR_ICH=y
CONFIG_SPINOR_INTEL=y

CONFIG_NETD=y
CONFIG_NETD_ETH=y
CONFIG_ETH_E1000=y
CONFIG_ETH_RTL8139=y

CONFIG_PARALLEL=y
CONFIG_PARALLEL_I8255=y

CONFIG_PCI=y
CONFIG_PCI_I386=y

CONFIG_PLATFORM=y
CONFIG_PVPANIC=y
CONFIG_PVPANIC_PLATFORM=y
CONFIG_PVPANIC_PCI=y

CONFIG_POWER=y
CONFIG_POWER_CE4100=y
CONFIG_POWER_CS5530A=y
CONFIG_POWER_CS5536=y
CONFIG_POWER_PIIX=y
CONFIG_POWER_PIIX4=y
CONFIG_POWER_RDC321X=y

CONFIG_RNG=y
CONFIG_RNG_INTEL_RDRAND=y
CONFIG_RNG_INTEL_PCH=y

CONFIG_RTC=y
CONFIG_RTC_MC146818=y

CONFIG_SERIO=y
CONFIG_SERIO_I8042=y

CONFIG_SND=y
CONFIG_SND_ES1370=y

CONFIG_UART=y
CONFIG_UART_8250=y
CONFIG_UART_8250_ISA=y

CONFIG_USB=y
CONFIG_USB_UHCI=y
CONFIG_USB_EHCI=y

CONFIG_VIDEO=y
CONFIG_VIDEO_VBE=y
CONFIG_VBE_BOCHS=y
CONFIG_VBE_VBOX=y

CONFIG_WATCHDOG=y
CONFIG_WATCHDOG_IB700=y
CONFIG_WATCHDOG_TCO=y

# fs
CONFIG_FS_CPIO=y

# kboot
CONFIG_LOAD_ADDR=0

# perload
CONFIG_CHIP_X86=y
CONFIG_PRELOAD=y
```

## configs/xtensa_defconfig
```kconfig
# Default configuration of x86 computer

CONFIG_ARCH_XTENSA=y

CONFIG_PAGE_OFFSET=0xc0000000

CONFIG_FRAMEWORK_DT=y
CONFIG_FRAMEWORK_UART=y
```

## crypto/Kconfig
```kconfig
# SPDX-License-Identifier: GPL-2.0-or-later
menuconfig CRYPTO
	bool "Cryptographic Support"

if CRYPTO

endif
```

## drivers/Kconfig
```kconfig
# SPDX-License-Identifier: GPL-2.0-or-later
menu "Device Drivers"

source "drivers/acpi/Kconfig"

source "drivers/ata/Kconfig"

source "drivers/block/Kconfig"

source "drivers/char/Kconfig"

source "drivers/clk/Kconfig"

source "drivers/clockevent/Kconfig"

source "drivers/clocksource/Kconfig"

source "drivers/cpufreq/Kconfig"

source "drivers/dt/Kconfig"

source "drivers/firmware/Kconfig"

source "drivers/gpio/Kconfig"

source "drivers/hid/Kconfig"

source "drivers/hwmon/Kconfig"

source "drivers/i2c/Kconfig"

source "drivers/input/Kconfig"

source "drivers/irqchip/Kconfig"

source "drivers/led/Kconfig"

source "drivers/mmc/Kconfig"

source "drivers/mfd/Kconfig"

source "drivers/mtd/Kconfig"

source "drivers/net/Kconfig"

source "drivers/parallel/Kconfig"

source "drivers/pci/Kconfig"

source "drivers/power/Kconfig"

source "drivers/serio/Kconfig"

source "drivers/reset/Kconfig"

source "drivers/rtc/Kconfig"

source "drivers/sound/Kconfig"

source "drivers/spi/Kconfig"

source "drivers/uart/Kconfig"

source "drivers/usb/Kconfig"

source "drivers/video/Kconfig"

source "drivers/watchdog/Kconfig"

endmenu
```

## drivers/acpi/Kconfig
```kconfig
menuconfig ACPI
    bool "Advanced Configuration Power Interface (ACPI) Support"
if ACPI

endif
```

## drivers/ata/Kconfig
```kconfig
# SPDX-License-Identifier: GPL-2.0-or-later
menuconfig ATA
    bool "Advanced Technology Attachment (ATA) Support"
if ATA

endif
```

## drivers/block/Kconfig
```kconfig
# SPDX-License-Identifier: GPL-2.0-or-later
menuconfig BLOCK
    bool "Block Device Support"
if BLOCK

source "drivers/block/partitions/Kconfig"

config BLK_FLOPPY
    bool "Floppy Disk Device Support"
    depends on ARCH_X86 && IRQCHIP_DT

config BLK_AHCISIM
    bool "Simple AHCI Controller Support"
    depends on PCI

config BLK_ATASIM
    bool "Simple ATA Controller Support"
    depends on PCI

config BLK_ATASIM32
    bool "Simple ATA 32bit PIO"
    depends on BLK_ATASIM

config BLK_NVMESIM
    bool "Simple NVME Controller Support"
    depends on PCI

endif
```

## drivers/block/partitions/Kconfig
```kconfig
# SPDX-License-Identifier: GPL-2.0-or-later
menu "Block Partition Support"

config PART_MSDOS
    bool "PC BIOS (MSDOS Partition) Partition Table Support"
    default y

config PART_EFI
    bool "EFI GUID (GPT) Partition Table Support"
    default y

config PART_SUN
    bool "Sun Partition Table Support"
    default y

config PART_MAC
    bool "Mac Partition Table Support"
    default y

endmenu
```

## drivers/buzzer/Kconfig
```kconfig
# SPDX-License-Identifier: GPL-2.0-or-later
menuconfig BUZZER
    bool "Buzzer Device Support"
if BUZZER

config BUZZER_PANIC
    bool "Trigger buzzer when panic"
    default y

comment "Buzzer Device Driver"

config BUZZER_PCSPKR
    bool "PC-Speaker Sound Support"
    depends on CLKEVT_I8253

endif # BUZZER
```

## drivers/cdrom/Kconfig
```kconfig
# SPDX-License-Identifier: GPL-2.0-or-later
menuconfig CDROM
    bool "Compact Disk (CD) Support"
if CDROM

endif
```

## drivers/char/Kconfig
```kconfig
# SPDX-License-Identifier: GPL-2.0-or-later
menuconfig CHAR
    bool "Char Device Support"
if CHAR

endif
```

## drivers/clk/Kconfig
```kconfig
# SPDX-License-Identifier: GPL-2.0-or-later
menuconfig CLK
    bool "Clock Device Support"
if CLK

config CLK_GX6605S
    bool "GX6605S Clock Support"
    depends on ARCH_CSKY
    select RESET

endif
```

## drivers/clockevent/Kconfig
```kconfig
# SPDX-License-Identifier: GPL-2.0-or-later
menu "Clock Event Device Support"

config CLKEVT_GX6605S
    bool "Gx6605s Timer Support"
    depends on ARCH_CSKY
    default y

config CLKEVT_HPET
    bool "High Precision Event Timer (HPET) Support"
    depends on ARCH_X86 && IRQCHIP_DT
    default y

config CLKEVT_I8253
    bool "I8253 Timer (PIT) Support"
    depends on ARCH_X86 && IRQCHIP_DT
    default y

endmenu
```

## drivers/clocksource/Kconfig
```kconfig
# SPDX-License-Identifier: GPL-2.0-or-later
menu "Clock Source Device Support"

config CLKSRC_ACPI_PM
    bool "ACPI Power Management Timer Support"
    depends on ACPI
    default y

config CLKSRC_HPET
    bool "High Precision Event Timer (HPET) Support"
    depends on CLKEVT_HPET
    default y

config CLKSRC_I8253
    bool "I8253 Timer (PIT) Support"
    depends on CLKEVT_I8253
    default y

config CLKSRC_TSC
    bool "Time Stamp Counter Support"
    depends on ARCH_X86
    default y

endmenu
```

## drivers/cpufreq/Kconfig
```kconfig
# SPDX-License-Identifier: GPL-2.0-or-later
menuconfig CPUFREQ
    bool "CPUFreq Device Support"
if CPUFREQ

source "drivers/cpufreq/core/Kconfig"

endif
```

## drivers/cpufreq/core/Kconfig
```kconfig
# SPDX-License-Identifier: GPL-2.0-or-later

config CPUFREQ_SCHED_ONDEMAND
    bool "Ondemand Scheduler Support"

config CPUFREQ_SCHED_PERFORMANCE
    bool "Performance Scheduler Support"

config CPUFREQ_SCHED_POWERSAVE
    bool "Powersave Scheduler Support"

choice
    prompt "Default CPUFreq Scheduler"

config CPUFREQ_SCHED_DEF_ONDEMAND
    bool "Ondemand"
    select CPUFREQ_SCHED_ONDEMAND

config CPUFREQ_SCHED_DEF_PERFORMANCE
    bool "Performance"
    select CPUFREQ_SCHED_PERFORMANCE

config CPUFREQ_SCHED_DEF_POWERSAVE
    bool "Powersave"
    select CPUFREQ_SCHED_POWERSAVE

endchoice
```

## drivers/cpuidle/Kconfig
```kconfig
# SPDX-License-Identifier: GPL-2.0-or-later
menuconfig CPUIDLE
    bool "CPU Idle Power Manager Support"
if CPUIDLE

source "drivers/cpuidle/governors/Kconfig"

config CPUIDLE_HALTPOLL
    bool "Halt poll cpuidle driver"
    depends on ARCH_HAS_CPU_IDLE

endif # CPUIDLE
```

## drivers/cpuidle/governors/Kconfig
```kconfig
# SPDX-License-Identifier: GPL-2.0-or-later
menu "CPU idle governors"

config CPUIDLE_GOV_HALTPOLL
    bool "Haltpoll governor"
    default y

endmenu # CPU idle governors
```

## drivers/dmi/Kconfig
```kconfig
# SPDX-License-Identifier: GPL-2.0-only

menuconfig DMI
    bool "DMI support"
if DMI

endif
```

## drivers/firmware/Kconfig
```kconfig
# SPDX-License-Identifier: GPL-2.0-or-later
menuconfig FIRMWARE
    bool "Firmware Device support"
if FIRMWARE

config FIRMWARE_DMI
    bool "DMI firmware support"

config FIRMWARE_QEMU
    bool "Qemu firmware support"

endif
```

## drivers/floppy/Kconfig
```kconfig
# SPDX-License-Identifier: GPL-2.0-or-later
menuconfig FLOPPY
    bool "Floppy Disk Device Support"
if FLOPPY

endif
```

## drivers/gpio/Kconfig
```kconfig
# SPDX-License-Identifier: GPL-2.0-or-later
menuconfig GPIO
    bool "General Purpose Input/Output (GPIO) Support"
if GPIO

config GPIO_DT
    bool "GPIO Device Tree Linkage"
    depends on DT
    default y

config GPIO_GENERIC
    bool "Generic GPIO Support"
    depends on DT

config GPIO_INTEL_ICH
    bool "Intel ICH GPIO Support"
    depends on MFD_ICH

config GPIO_PARALLEL
    bool "Parallel GPIO Bridge"
    depends on PARALLEL && DT

config GPIO_PCF8574
    bool "PCF8574 Bridge Support"

endif
```
