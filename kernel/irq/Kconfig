## kernel/irq/Kconfig
```kconfig
# SPDX-License-Identifier: GPL-2.0-or-later
config SOFTIRQ_LIMIT
    int "Max softirq limit"
    default 256

config IRQPOLL_CAPACITY
    int "Max irqpoll capacity"
    default 256
```

## kernel/printk/Kconfig
```kconfig
# SPDX-License-Identifier: GPL-2.0-or-later
menuconfig PRINTK
    bool "Printk Support"
    default y
if PRINTK

config DYNAMIC_DEBUG
    bool "Kernel dynamic debug"
    default y

config PRINTK_TIME
    bool "Show timing information"
    default y

config PRINTK_COLOR
    bool "Show level color"
    default y

config PRINTK_LOGLEVEL_DEFAULT
    int "Default console loglevel"
    depends on PRINTK
    range 0 PRINTK_LOGLEVEL_MAX
    default 4

config PRINTK_LOGLEVEL_QUIET
    int "Quiet console loglevel"
    range 0 PRINTK_LOGLEVEL_MAX
    default 4

config PRINTK_LOGLEVEL_MAX
    int "Maximum console loglevel"
    range 0 7 if !DYNAMIC_DEBUG
    range 7 7 if DYNAMIC_DEBUG
    default 7

config CONSOLE_PREFERREDS
    int "Maximum console parameters"
    default 16

config EARLYCON
    bool "Early console support"
    default y

endif # Printk Config
```

## kernel/sched/Kconfig
```kconfig
# SPDX-License-Identifier: GPL-2.0-or-later
menu "Scheduler Config"

config PREEMPT_DYNAMIC
    bool "Preemption behaviour defined on boot"
    select PREEMPTION
    default y

config PREEMPTION
    bool

choice
    prompt "Preemption Model"
    default PREEMPT_REALTIME

config PREEMPT_NONE
    bool "None Preemption"

config PREEMPT_VOLUNTARY
    bool "Voluntary Preemption"

config PREEMPT_FORCE
    bool "Force Preemption"
    select PREEMPTION

config PREEMPT_REALTIME
    bool "Real Time Preemption"
    select PREEMPTION

endchoice # Preemption Model

config SCHED_RR
    bool "Round Robin (RR) Scheduler Support"
    default y

config SCHED_FIFO
    bool "First In First Out (FIFO) Scheduler Support"
    default y

config SCHED_FAIR
    bool "Fair Scheduler Support"

choice
    prompt "Default Scheduler Choice"
    default SCHED_DEF_RR

config SCHED_DEF_RR
    bool "Round Robin"
    select SCHED_RR

config SCHED_DEF_FIFO
    bool "First In First Out"
    select SCHED_FIFO

config SCHED_DEF_FAIR
    bool "Fair"
    select SCHED_FAIR

endchoice # Default Scheduler Choice

config RR_TIMESLICE
    int "Round Robin Time Slice (ms)"
    depends on SCHED_RR
    range 10 1000
    default 50

endmenu # Scheduler Config
```

## kernel/time/Kconfig
```kconfig
# SPDX-License-Identifier: GPL-2.0-or-later
menu "Timer config"
config TIMER_SHIFT
    int "Timer level divisor shift"
    default 3

config TIMER_LEVEL
    int "Timer level size shift"
    default 6

config TIMER_DEPTH
    int "Timer level depth"
    default 8

choice
    prompt "Timer tick handling"

config TICK_PERIODIC
    bool "Periodic timer ticks"

config TICK_DYNAMIC
    bool "Idle dynticks system"

endchoice
endmenu
```

## lib/Kconfig
```kconfig
# SPDX-License-Identifier: GPL-2.0-or-later
menu "Library Routines"

source "lib/font/Kconfig"

source "lib/libgcc/Kconfig"

endmenu
```

## lib/crc/Kconfig
```kconfig
config LIB_CRC4
bool "Enable CRC4 functions"
default y

config LIB_CRC8 
bool "Enable CRC8 functions"
default y

config LIB_CRC16 
bool "Enable CRC16 functions"
default y

config LIB_CRC32
bool "Enable CRC32 functions"
default y

config LIB_CRC64
bool "Enable CRC64 functions"
default y
```

## lib/font/Kconfig
```kconfig
# SPDX-License-Identifier: GPL-2.0-or-later
menuconfig FONT
    bool "Font Library"
    default y
if FONT

config FONT_4X6
    bool "4x6 font"
    default y

config FONT_6X8
    bool "6x8 font"
    default y

config FONT_6X10
    bool "6x10 font"
    default y

config FONT_6X11
    bool "6x11 font"
    default y

config FONT_7X14
    bool "7x14 font"
    default y

config FONT_8X8
    bool "8x8 font"
    default y

config FONT_8X16
    bool "8x16 font"
    default y

config FONT_10X18
    bool "10x18 font"
    default y

config FONT_12X22
    bool "12x2 font"
    default y

config FONT_16X32
    bool "16x32 font"
    default y

endif
```

## lib/libc/Kconfig
```kconfig
menuconfig LIB_LIBC
    bool "Builtin Standard C library"
    default n
    
if LIB_LIBC
    
    source "lib/libc/ctype/Kconfig"
    
    source "lib/libc/errno/Kconfig"
    
    source "lib/libc/stdio/Kconfig"
    
    source "lib/libc/stdlib/Kconfig"
    
    source "lib/libc/string/Kconfig"
    
    source "lib/libc/time/Kconfig"

endif
```

## lib/libgcc/Kconfig
```kconfig
# SPDX-License-Identifier: GPL-2.0-or-later
config LIBGCC_BASE
    bool

config LIBGCC_DIVSI3
    bool

config LIBGCC_DIVDI3
    bool

config LIBGCC_SOFTFP
    bool
```

## mm/Kconfig
```kconfig
# SPDX-License-Identifier: GPL-2.0-or-later
menu "Memory Management Options"

comment "Architecture has no MMU"
	depends on !ARCH_HAS_MMU

config MMU
	bool "MMU-based Paged Memory Management Support"
	depends on ARCH_HAS_MMU
	default y
	help
		Select if you want MMU-based virtualised addressing space
		support by paged memory management. If unsure, say 'Y'.

config XIP
	bool "Execute-In-Place from ROM"
	depends on ARCH_HAS_XIP

config XIP_BASE
	hex "XIP base address"
	depends on XIP

config RAM_BASE
	hex "RAM base address"
	default 0
	help
		Start address of physical memory.

config RAM_PAD
	hex "RAM padding size"
	depends on MMU
	default 0
	help
		Memory pad for special memory model.

menu "Memory region"

config REGION_DMA
	bool "DMA region"

config DMA_SIZE
	hex "DMA size"
	depends on REGION_DMA

config REGION_DMA32
	bool "DMA32 region"
	depends on REGION_DMA

config DMA32_SIZE
	hex "DMA32 size"
	depends on REGION_DMA32

config REGION_HIMEM
	bool "Himem region"
	depends on MMU
	help
		If direct mapping cannot access all memory, turn on
		the high-end memory option

config HIGHMEM_OFFSET
	hex "Himem offset"
	depends on REGION_HIMEM

endmenu # Memory region

choice
	prompt "Memory model"
	default SPARCEMEM

config FLATMEM
	bool "Flat model"

config SPARCEMEM
	bool "Sparce model"

endchoice # Memory model

config PAGE_OFFSET
	hex "Page offset"

config PAGE_ORDER_MAX
	int "Page max order"
	default 11

config SPARCE_SHIFT
	int "Sparce section size shift"
	depends on SPARCEMEM

config IOREMAP_OFFSET
	hex "I/O remap offset"
	depends on ARCH_HAS_IOMAP

config HIGHMAP_OFFSET
	hex "Highmap memory offset"
	depends on REGION_HIMEM
	help
		The virtual address to which the high-end memory
		will be mapped.

config HIGHMAP_SIZE
	hex "Highmap memory Size"
	depends on REGION_HIMEM

choice
	prompt "Kmem allocator select"
	default MM_SLOB

config MM_SLAB
	bool "Slab allocator"

config MM_SLOB
	bool "Slob allocator"

endchoice # Kmem allocator select

menu "Slob config"
	depends on MM_SLOB

config SLOB_MEDIUM_LINE
	int "Medium page boundary"
	default 256

config SLOB_HUGE_LINE
	int "Large page boundary"
	default 512

endmenu # Slob config

config MEMBLK_REGIONS
	int "Memblock maximum regions"
	default 128

config MEMBLK_MERGE
	bool "Memblock merge identical regions"
	help
		It may be possible to turn on this feature in
		the case of insufficient memory blocks.

config MEMTEST
	bool "Memory test support"
	default y

endmenu # Memory Management Options

config PGTABLE_LEVEL5
	bool
	select PGTABLE_LEVEL4

config PGTABLE_LEVEL4
	bool
	select PGTABLE_LEVEL3

config PGTABLE_LEVEL3
	bool

config PGTABLE_LEVEL
	int
	default 5 if PGTABLE_LEVEL5
	default 4 if PGTABLE_LEVEL4
	default 3 if PGTABLE_LEVEL3
	default 2
```

## mm/kasan/Kconfig
```kconfig
# SPDX-License-Identifier: GPL-2.0-or-later
menuconfig KASAN
    bool "Runtime Memory Monitor Support"
    depends on ARCH_HAS_KASAN
    default y
if KASAN

choice
    prompt "KASAN Mode Select"
    default KASAN_GENERIC

config KASAN_GENERIC
    bool "Generic Mode"

endchoice

endif
```

## net/Kconfig
```kconfig
# SPDX-License-Identifier: GPL-2.0-or-later
menuconfig NET
    bool "Networking support"
```

## system/Kconfig.comp
```kconfig
menu "Compile config"
    
choice
    prompt "Compiler optimization level"
    default CC_OPTIMIZE_FOR_DEBUG
        
config CC_OPTIMIZE_FOR_DEBUG
    bool "Optimize for debug (-O0)"
        
config CC_OPTIMIZE_FOR_PERFORMANCE
    bool "Optimize for performance (-O2)"
        
config CC_OPTIMIZE_FOR_SIZE
    bool "Optimize for size (-Os)"
    
endchoice
    
config STRICT
    bool "Compiling kernel with strict mode"
    default y    
    help 
    Use -Wall and -Werror, To ensure kernel 
    security, please keep it open in the mainline
    
config KERNEL_DEBUG
    bool "Kernel generate debug file"
    default y    

config KERNEL_MAP
    bool "generate map file"
    default n
    
config LD_DEAD_CODE_DATA_ELIMINATION
    bool "Dead code and data elimination (EXPERIMENTAL)"
    default n

endmenu

 
```

## system/Kconfig.debug
```kconfig
menu "Kernel hacking" 

    config PRINTK
    bool "printk"
    default y

    config DYNAMIC_DEBUG
    bool "Kernel generate debug file"
    depends on PRINTK
    default y
    help
        Compiles debug level messages into the kernel
    
    config PRE_PRINTK
    bool "Kernel generate debug file"
    depends on ARCH_HAS_PRE_PRINTK
    default y
    
    
endmenu
```

## system/Kconfig.general
```kconfig
config VERSION
    string
    default $(KERNELVERSION)

menu "General setup"

    config DEFAULT_HOSTNAME
    string "Default hostname"
    default "none"
    help
        This option determines the default system hostname before userspace
        calls sethostname(2). The kernel traditionally uses "(none)" here,
        but you may wish to use a different default here to make a minimal
        system more usable with less configuration.
            
    config DEFAULT_INIT
    string "Default init path"
    default ""
    help
        This option determines the default init for the system if no init=
        option is passed on the kernel command line. If the requested path is
        not present, we will still then move on to attempting further
        locations (e.g. /sbin/init, etc). If this is empty, we will just use
        the fallback list when init= is not passed.
        
    config SYSVIPC
    bool "System V IPC"
    default y
        
    config EXPERT
    bool "Configure standard kernel features (expert users)"
    help
        This option allows certain base kernel options and settings
        to be disabled or tweaked. This is for specialized
        environments which can tolerate a "non-standard" kernel.
        Only use this if you really know what you are doing.
            
    config BOOT_PARAMS
    bool "Accept kernel instructions"
    default y
    
    config BUILTIN_DTB
    bool "builtin dtb"

    config BUILTIN_DTB_PATH
    string "builtin dtb path"
    depends on BUILTIN_DTB
    
endmenu 
```

## test/Kconfig
```kconfig
# SPDX-License-Identifier: GPL-2.0-or-later
menu "Kernel Selftest"

config TEST_CRC32
    bool "CRC32 Selftest (Benchmark)"

endmenu
```

## usr/Kconfig
```kconfig
# SPDX-License-Identifier: GPL-2.0-or-later
menuconfig KUSER
    bool "Kernel Application"
    default y
if KUSER

config KSHELL
    bool "Kshell support"
    default y

source "usr/kshell/Kconfig"

source "usr/command/Kconfig"

source "usr/manual/Kconfig"

source "usr/selftest/Kconfig"

endif # KUSER
```

## usr/command/Kconfig
```kconfig
# SPDX-License-Identifier: GPL-2.0-or-later
menu "Kshell Command Shell"
    depends on KSHELL

config KCMD_ASCII85
    bool "ascii85"
    default y

config KCMD_BASE32
    bool "base32"
    default y

config KCMD_BASE64
    bool "base64"
    default y

config KCMD_BASENAME
    bool "basename"
    default y

config KCMD_BREAK
    bool "break"
    default y

config KCMD_CLEAR
    bool "clear"
    default y

config KCMD_COND
    bool "cond"
    default y

config KCMD_CONTINUE
    bool "continue"
    default y

config KCMD_DELAY
    bool "delay"
    default y

config KCMD_ECHO
    bool "echo"
    default y

config KCMD_ENV
    bool "env"
    default y

config KCMD_ERRNAME
    bool "errname"
    default y

config KCMD_EXIT
    bool "exit"
    default y

config KCMD_EXPORT
    bool "export"
    default y

config KCMD_FALSE
    bool "false"
    default y

config KCMD_FUNC
    bool "func"
    default y

config KCMD_GOTO
    bool "goto"
    default y

config KCMD_GPIO
    bool "gpio"
    default y

config KCMD_GREP
    bool "grep"
    default y

config KCMD_HEAD
    bool "head"
    default y

config KCMD_LOCAL
    bool "local"
    default y

config KCMD_LOOP
    bool "loop"
    default y

config KCMD_LSPCI
    bool "lspci"
    default y

config KCMD_MATH
    bool "math"
    default y

config KCMD_MEM
    bool "memory"
    default y

config KCMD_NATIVE
    bool "native"
    default y

config KCMD_PANIC
    bool "panic"
    default y

config KCMD_PRINTF
    bool "printf"
    default y

config KCMD_READ
    bool "read"
    default y

config KCMD_REBOOT
    bool "reboot"
    default y

config KCMD_REPEAT
    bool "repeat"
    default y

config KCMD_RETURN
    bool "return"
    default y

config KCMD_SELECT
    bool "select"
    default y

config KCMD_SEQ
    bool "seq"
    default y

config KCMD_SILENT
    bool "silent"
    default y

config KCMD_SLEEP
    bool "sleep"
    default y

config KCMD_SWITCH
    bool "switch"
    default y

config KCMD_SYMBOL
    bool "symbol"
    default y

config KCMD_TAIL
    bool "tail"
    default y

config KCMD_TIME
    bool "time"
    default y

config KCMD_TRUE
    bool "true"
    default y

config KCMD_TRYRUN
    bool "tryrun"
    default y

config KCMD_UNTIL
    bool "until"
    default y

config KCMD_UPTIME
    bool "uptime"
    default y

config KCMD_VERSION
    bool "verison"
    default y

config KCMD_WATCH
    bool "watch"
    default y

config KCMD_WC
    bool "wc"
    default y

config KCMD_WHILE
    bool "while"
    default y

config KCMD_XMODEM
    bool "xmodem"
    default y

config KCMD_YES
    bool "yes"
    default y

source "usr/command/arch/Kconfig"

endmenu # Kshell Command Shell
```

## usr/command/arch/Kconfig
```kconfig
# SPDX-License-Identifier: GPL-2.0-or-later
config KCMD_ARCH_X86_CPUID
    bool "x86-cpuid"
    depends on ARCH_X86
    default y

config KCMD_ARCH_X86_MSR
    bool "x86-msr"
    depends on ARCH_X86
    default y

config KCMD_ARCH_X86_SMI
    bool "x86-smi"
    depends on ARCH_X86
    default y

config KCMD_ARCH_X86_TSC
    bool "x86-tsc"
    depends on ARCH_X86
    default y
```

## usr/kshell/Kconfig
```kconfig
# SPDX-License-Identifier: GPL-2.0-or-later
menu "Kshell config"
    depends on KSHELL

config KSHELL_DEPTH
    int "Kshell maximum depth"
    default 24

config KSHELL_BOOTARGS
    int "Kshell maximum bootargs"
    default 8

config KSHELL_DEF_PS1
    string "Kshell default PS1"
    default "kshell: /# "

config KSHELL_DEF_PS2
    string "Kshell default PS2"
    default "-> "

config KSHELL_DEF_PS3
    string "Kshell default PS3"
    default "?# "

endmenu # Kshell config
```

## usr/manual/Kconfig
```kconfig
# SPDX-License-Identifier: GPL-2.0-or-later
menuconfig KSH_MANUAL
    bool "Kshell command manual"
    depends on KSHELL
    default y
if KSH_MANUAL

source "usr/manual/kshell/Kconfig"

endif
```

## usr/manual/kshell/Kconfig
```kconfig
# SPDX-License-Identifier: GPL-2.0-or-later
menuconfig MANUAL_KSHELL
    bool "Kshell Manual"
    default y
if MANUAL_KSHELL

config MANUAL_KSHELL_SHORTCUT
    bool "Kshell Shortcut Introduce"
    default y

endif # MANUAL_KSHELL
```

## usr/selftest/Kconfig
```kconfig
# SPDX-License-Identifier: GPL-2.0-or-later
menuconfig KSH_SELFTEST
    bool "Kernel module selftest"
    depends on KSHELL
    default y
if KSH_SELFTEST

source "usr/selftest/control/Kconfig"

source "usr/selftest/benchmark/Kconfig"

source "usr/selftest/driver/Kconfig"

source "usr/selftest/filter/Kconfig"

source "usr/selftest/kernel/Kconfig"

source "usr/selftest/kshell/Kconfig"

source "usr/selftest/lib/Kconfig"

source "usr/selftest/math/Kconfig"

source "usr/selftest/memory/Kconfig"

endif # KSH_SELFTEST
```
